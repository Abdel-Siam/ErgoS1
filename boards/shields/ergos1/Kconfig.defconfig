## boards/shields/ergos1/Kconfig.defconfig
```kconfig
if SHIELD_ERGOS1_LEFT

config ZMK_KEYBOARD_NAME
	default "Ergo-S1"

config ZMK_SPLIT_BLE_ROLE_CENTRAL
	default y

config ZMK_USB
	default y

endif

if SHIELD_ERGOS1_LEFT || SHIELD_ERGOS1_RIGHT

config ZMK_SPLIT
	default y
	
endif
```
